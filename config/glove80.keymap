// vim: set ts=20 noet nowrap :

#include "glove80_pos.h"
#include "zmk_helpers.h"
#include "behaviors.dtsi"

// layers
#define BASEIMP 0 //Default layer applied when ZMK starts
#define MASK    1 //mask down to 48 keys
#define BASE    2 //This layer has the combos for the BASEIMP layer
#define MRR     3 //flip sides (MIRROR)
#define SYNUM   4 //Symbol-Number
#define FN      5 //FNx layer
#define NMPD    6 //Number pad
#define RVIM    7 //vim vim emu, triggered by CMD but only right side usable
#define CMD     8 //cmd layer geared toward WIN commands and left hand nav
#define LVIM    9 //vim emu where left side overrides CMD
#define VVIM    10 //visual vim commands
#define CVIM    11 //vim emu control cmds
#define SVIM    12 //vim+symbol layer
#define SYS     13 //utility fn.  Volume, etc.
#define MGC     14 //moergo magic

#define STD_LAYERS BASEIMP BASE NMPD SYNUM SYS
#define VIM_LAYERS LVIM VVIM RVIM CVIM SVIM


#include "vim.dtsi"


DEFZ {

    BEHAVIORZ {
	ZHOLD_TAP( mht,		&kp, &kp,	hold-preferred,	SLOW_HOLD,	SSLOW_DOUBLE )
	ZHOLD_TAP( nl,		&mo, &num_word,	balanced,	SLOW_HOLD )

    };

    COMBOZ {
	//modifiders
	ZCOMBO( combo_W_E_1,	POS_W POS_E,		&mht LGUI GRAVE,	FAST_COMBO,	STD_LAYERS )
	ZCOMBO( combo_W_E_2,	POS_W POS_E,		&mht LGUI BSLH,	FAST_COMBO,	MRR )
	ZCOMBO( combo_W_E_3,	POS_W POS_E,		&alt_tab,	FAST_COMBO,	CMD )
	ZCOMBO( combo_W_E_5,	POS_W POS_E,		&sk LGUI,	FAST_COMBO,	FN )

	ZCOMBO( combo_O_I_1,	POS_O POS_I,		&mht LGUI BSLH,	FAST_COMBO,	STD_LAYERS CMD )
	ZCOMBO( combo_O_I_2,	POS_O POS_I,		&mht LGUI GRAVE,	FAST_COMBO,	MRR )

	ZCOMBO( combo_S_D_1,	POS_S POS_D,		&mht LALT ESC,	FAST_COMBO,	STD_LAYERS CMD )
	ZCOMBO( combo_S_D_2,	POS_S POS_D,		&mht LALT FSLH,	FAST_COMBO,	MRR )
	ZCOMBO( combo_S_D_3,	POS_S POS_D,		&sk LALT,	FAST_COMBO,	FN )

	ZCOMBO( combo_L_K_1,	POS_L POS_K,		&mht LT FSLH,	FAST_COMBO,	STD_LAYERS )
	ZCOMBO( combo_L_K_2,	POS_L POS_K,		&mht LALT ESC,	FAST_COMBO,	MRR )
	ZCOMBO( combo_L_K_3,	POS_L POS_K,		&kp LC(F),	FAST_COMBO,	CMD VIM_LAYERS )

	ZCOMBO( combo_X_C_1,	POS_X POS_C,		&kp LCTRL,	MED_COMBO,	STD_LAYERS MRR )
	ZCOMBO( combo_X_C_2,	POS_X POS_C,		&mo CVIM,	MED_COMBO,	CMD VIM_LAYERS )
	ZCOMBO( combo_X_C_3,	POS_X POS_C,		&sk LCTRL,	MED_COMBO,	FN )

	ZCOMBO( combo_DOT_COMMA_1,	POS_DOT POS_COMMA,		&mht LCTRL MINUS,	MED_COMBO,	STD_LAYERS MRR )
	ZCOMBO( combo_DOT_COMMA_2,	POS_DOT POS_COMMA,		&mo CVIM,	MED_COMBO,	CMD VIM_LAYERS )


	ZCOMBO( combo_X_D_1,	POS_X POS_D,		&kp LC(LALT),	MED_COMBO,	STD_LAYERS MRR )
	ZCOMBO( combo_X_D_2,	POS_X POS_D,		&sk LC(LALT),	MED_COMBO,	CMD )
	ZCOMBO( combo_DOT_K,	POS_DOT POS_K,		&kp LC(LALT),	MED_COMBO,	STD_LAYERS MRR )

	ZCOMBO( combo_S_E_1,	POS_S POS_E,		&kp LA(LGUI),	FAST_COMBO,	STD_LAYERS MRR )
	ZCOMBO( combo_S_E_2,	POS_S POS_E,		&sk LA(LGUI),	FAST_COMBO,	CMD )
	ZCOMBO( combo_L_I,		POS_L POS_I,		&kp LA(LGUI),	FAST_COMBO,	STD_LAYERS MRR )


	ZCOMBO( combo_X_R_1,	POS_X POS_R,		&kp LC(LGUI),	MED_COMBO,	STD_LAYERS MRR )
	ZCOMBO( combo_X_R_2,	POS_X POS_R,		&sk LC(LGUI),	MED_COMBO,	CMD )
	ZCOMBO( combo_DOT_U,	POS_DOT POS_U,		&kp LC(LGUI),	MED_COMBO,	STD_LAYERS MRR )

	ZCOMBO( combo_X_D_R_1,	POS_X POS_D POS_R,		&kp LC(LA(LGUI)),	SLOW_COMBO,	STD_LAYERS MRR )
	ZCOMBO( combo_X_D_R_2,	POS_X POS_D POS_R,		&sk LC(LA(LGUI)),	SLOW_COMBO,	CMD )
	ZCOMBO( combo_DOT_K_U,	POS_DOT POS_K POS_U,	&kp LC(LA(LGUI)),	SLOW_COMBO,	STD_LAYERS MRR )


	//layers
	ZCOMBO( combo_RHR1C1_RHR1C2,	RH_R1C1 RH_R1C2,		&to BASEIMP,	SLOW_COMBO,	ALL_LAYERS )
	ZCOMBO( combo_LHR1C1_LHR1C2,	LH_R1C1 LH_R1C2,		&to BASEIMP,	SLOW_COMBO,	ALL_LAYERS )

	ZCOMBO( combo_D_F_1,	POS_D POS_F,		&nl SYNUM SYNUM,	FAST_COMBO,	STD_LAYERS MRR )
	ZCOMBO( combo_D_F_2,	POS_D POS_F,		&sl SYNUM,	FAST_COMBO,	FN )
	ZCOMBO( combo_D_F_3,	POS_D POS_F,		&mo SVIM,	FAST_COMBO,	CMD VIM_LAYERS )

	ZCOMBO( combo_K_J_1,	POS_K POS_J,		&mokp SYNUM SQT,	FAST_COMBO,	STD_LAYERS MRR )
	ZCOMBO( combo_K_J_2,	POS_K POS_J,		&mo SVIM,	FAST_COMBO,	CMD VIM_LAYERS )

	ZCOMBO( combo_E_F_1,	POS_E POS_F,		&mo FN, 	SLOW_COMBO,	BASE MRR )
	ZCOMBO( combo_E_F_2,	POS_E POS_F,		&sl FN,	SLOW_COMBO,	FN )

	ZCOMBO( combo_I_J,		POS_I POS_J,		&mo FN,	SLOW_COMBO,	BASE MRR )

	ZCOMBO( combo_D_V_1,	POS_D POS_V,		&nl NMPD NMPD, 	SLOW_COMBO,	BASE MRR )
	ZCOMBO( combo_D_V_2,	POS_D POS_V,		&sl NMPD,	SLOW_COMBO,	FN )

	ZCOMBO( combo_K_M_1,	POS_K POS_M,		&nl NMPD NMPD,	FAST_COMBO,	BASE MRR )
	ZCOMBO( combo_K_M_2,	POS_K POS_M,		&sl NMPD,	FAST_COMBO,	SYS )

    };

    MACROZ {
	ZMACRO1( mml
			,<&macro_param_1to1>
			,<&macro_press &mo MACRO_PLACEHOLDER>
			,<&macro_pause_for_release>
			,<&macro_param_1to1>
			,<&macro_release &mo MACRO_PLACEHOLDER>
			,<&macro_release &kp RSHFT>
			)

	ZMACRO0( desel
			,<&macro_tap &kp RIGHT &kp LEFT>
			)
	ZMACRO1( clip
			,<&macro_param_1to1>
			,<&macro_tap &kp MACRO_PLACEHOLDER>
			)


    };
};

//common keys
DEFZ {

    BEHAVIORZ {
	ZHOLD_TAP( mokp,		&mo, &kp,	balanced,	SLOW_HOLD,	MED_DOUBLE )
	ZHOLD_TAP( motg,		&mo, &tog,	balanced,	SLOW_HOLD )

	ZHOLD_TAP( clt,		&mml, &kp,	balanced,	SLOW_HOLD,	SLOW_DOUBLE )
	ZHOLD_TAP( hpt,		&ka,  &kp,	hold-preferred,	SLOW_HOLD,	SLOW_DOUBLE )
	ZHOLD_TAP( ht,		&ka,  &kp,	balanced,	SLOW_HOLD,	SLOW_DOUBLE )
	ZHOLD_TAP( htp,		&ka,  &kp,	tap-preferred,	SLOW_HOLD,	SLOW_DOUBLE )

	ZMOD_MORPH( mm_cw_caps,	MOD_LSFT,	&caps_word,	&kp CAPS )
    };

    COMBOZ {
	ZCOMBO( combo_S_F,		POS_S POS_F,	&kp RET,	SLOW_COMBO,	ALL_LAYERS,		NORMAL_RELEASE )
	ZCOMBO( combo_L_J,		POS_L POS_J,	&kp RET,	SLOW_COMBO,	ALL_LAYERS,		NORMAL_RELEASE )

	ZCOMBO( combo_LHR4C1_A_1,	LH_R4C1 POS_A,	&kp RET,	SLOW_COMBO,	ALL_LAYERS,		NORMAL_RELEASE )
	ZCOMBO( combo_SQT_SEMI,	POS_SQT POS_SEMI,	&kp RET,	SLOW_COMBO,	ALL_LAYERS,		NORMAL_RELEASE )

	ZCOMBO( combo_COMMA_M,	POS_COMMA POS_M,	&kp UNDER,	SLOW_COMBO,	STD_LAYERS CMD VIM_LAYERS,	NORMAL_RELEASE )
	ZCOMBO( combo_C_V,		POS_C POS_V,	&kp UNDER,	SLOW_COMBO,	MRR,		NORMAL_RELEASE )

	ZCOMBO( combo_O_U,		POS_O POS_U,	&kp EQUAL,	FAST_COMBO,	STD_LAYERS CMD VIM_LAYERS,	NORMAL_RELEASE )
	ZCOMBO( combo_W_R,		POS_W POS_R,	&kp EQUAL,	FAST_COMBO,	MRR,		NORMAL_RELEASE )

	ZCOMBO( combo_A_F,		POS_A POS_F,	&mm_cw_caps,	MED_COMBO,	ALL_LAYERS,		NORMAL_RELEASE )
	ZCOMBO( combo_SEMI_J,	POS_SEMI POS_J,	&mm_cw_caps,	SLOW_COMBO,	ALL_LAYERS,		NORMAL_RELEASE )
    };

};


//magic layer
DEFZ {
    BEHAVIORZ {
	ZHOLD_TAP( mgc,	&mo,  &rgb_ug_status_macro,	tap-preferred,	MED_HOLD )
    };

    MACROZ {
	ZMACRO0( rgb_ug_status_macro
			,<&rgb_ug RGB_STATUS> 
			)

	ZMACRO0( bt_0
			,<&out OUT_BLE>
			,<&bt BT_SEL 0>
			)

	ZMACRO0( bt_1
			,<&out OUT_BLE>
			,<&bt BT_SEL 1>
			)

	ZMACRO0( bt_2
			,<&out OUT_BLE>
			,<&bt BT_SEL 2>
			)

	ZMACRO0( bt_3
			,<&out OUT_BLE>
			,<&bt BT_SEL 3>
			)


    };
};




DEFZ {
    COND_LAYERZ {
        ZCOND_LAYER( base_layer,	BASE,	BASEIMP )
        ZCOND_LAYER( cmd_layer,	RVIM,	CMD )
    };


    LAYERZ {

        #define BASE_KEYMAP \
	&kp F1,	&kp F2,	&kp F3,	&kp F4,	&kp F5,									&kp F6,	&kp F7,	&kp F8,	&kp F9,	&kp F10, \
	&kp GRAVE,	&kp N1,	&kp N2,	&kp N3,	&kp N4,	&kp N5,							&kp N6,	&kp N7,	&kp N8,	&kp N9,	&kp N0,	&kp BSLH, \
	&mt LALT Q,	&kp Q,	&kp W,	&kp E,	&kp R,	&ak_T,							&kp Y,	&kp U,	&kp I,	&kp O,	&kp P,	&kp P, \
	&mokp MRR TAB,	&htp LSHFT A,	&kp S,	&kp D,	&kp F,	&kp G,							&kp H,	&kp J,	&kp K,	&kp L,	&kp SEMI,	&mokp MRR SQT, \
	&kp LCTRL,	&hpt LSHFT Z,	&kp X,	&kp C,	&kp V,	&kp B,	&mokp LVIM BSPC,	&kp DEL,	&mo MRR,	&lt MRR C_MUTE,	&kp TAB,	&clt CMD SPACE,	&kp N,	&kp M,	&kp COMMA,	&kp DOT,	&ht LSHFT UP,	&ht LSHFT FSLH, \
	&kp DEL,	&kp INS,	&mgc MGC 0,	&kp HOME,	&kp END,		&ht LSHFT SPACE,	&clt CMD TAB,	&motg FN LVIM,	&mokp SYS INS,	&mokp LVIM DEL,	&ht LSHFT BSPC,		&kp PG_UP,	&kp PG_DN,	&kp LEFT,	&kp DOWN,	&kp RIGHT

        ZKEYMAP( BASEIMP, GLOVE80_MAP( BASE_KEYMAP ) )

        ZKEYMAP( MASK,
	_x_	_x_	_x_	_x_	_x_									_x_	_x_	_x_	_x_	_x_
	_x_	_x_	_x_	_x_	_x_	_x_							_x_	_x_	_x_	_x_	_x_	_x_
	___	___	___	___	___	___							___	___	___	___	___	___
	___	___	___	___	___	___							___	___	___	___	___	___
	___	___	___	___	___	___	___	___	___	___	___	___	___	___	___	___	___	___
	_x_	_x_	___	_x_	_x_		___	___	___	___	___	___		_x_	_x_	_x_	_x_	_x_
        )

        //Totally transparent.  Only for combos so they are no hidden by MASK when it is on
        ZKEYMAP( BASE,
	___	___	___	___	___									___	___	___	___	___
	___	___	___	___	___	___							___	___	___	___	___	___
	___	___	___	___	___	___							___	___	___	___	___	___
	___	___	___	___	___	___							___	___	___	___	___	___
	___	___	___	___	___	___	___	___	___	___	___	___	___	___	___	___	___	___
	___	___	___	___	___		___	___	___	___	___	___		___	___	___	___	___
        )


        ZKEYMAP( MRR, GLOVE80_MIRROR( BASE_KEYMAP ) )



        ZKEYMAP( SYNUM,
	___	___	___	___	___									___	___	___	___	___
	___	___	___	___	___	___							___	___	___	___	___	___
	___	_x_	&kp LBRC 	&kp LPAR	&kp RPAR	&kp RBRC							_x_ 	&kp LBKT	&kp RBKT	_x_	_x_	___
	___	&kp N1	&kp N2	&kp N3	&kp N4	&kp N5							&kp N6	&kp N7	&kp N8	&kp N9	&kp N0	___
	___	&kp EXCL	&kp AT	&kp HASH	&kp DLLR	&kp PRCNT	___	___	___	___	___	___	&kp CARET	&kp AMPS	&kp STAR	_x_ 	_x_	___
	___	___	___	___	___		___	___	&tog SYNUM	&tog SYNUM	___	___		___	___	___	___	___
        )

        ZKEYMAP( FN,
	_x_	_x_	_x_	_x_	_x_									_x_	_x_	_x_	_x_	_x_
	_x_	_x_	_x_	_x_	_x_	_x_							_x_	_x_	_x_	_x_	_x_	_x_
	_x_	&kp F11	&kp F12 	&kp F13	&kp F14	&kp F15							&kp F16	&kp F17	&kp F18	&kp F19	&kp F20	_x_
	_x_	&kp F1	&kp F2 	&kp F3	&kp F4	&kp F5							&kp F6	&kp F7	&kp F8	&kp F9	&kp F10	_x_
	_x_	_x_	&kp LS(DEL)	&kp LC(INS)	&kp LS(INS)	_x_	___	___	___	___	___	___	_x_	_x_	_x_	_x_	_x_	_x_
	_x_	_x_	_x_	_x_	_x_		___	___	___	___	___	___		_x_	_x_	_x_	_x_	_x_
        )

        ZKEYMAP( NMPD,
	_x_	_x_	_x_	_x_	_x_									_x_	_x_	_x_	_x_	_x_
	_x_	_x_	_x_	_x_	_x_	_x_							_x_	&kp ESC	&kp FSLH	&kp STAR	_x_	_x_
	_x_	_x_	_x_	_x_	_x_	_x_							&kp FSLH	&kp N7	&kp N8	&kp N9	&kp MINUS	_x_
	_x_	_x_	_x_	_x_	_x_	_x_							&kp STAR	&kp N4	&kp N5	&kp N6	&kp PLUS	_x_
	_x_	_x_	_x_	_x_	_x_	_x_	___	___	___	___	___	___	&kp N0	&kp N1	&kp N2	&kp N3	&kp DOT	_x_
	___	___	___	___	___		___	___	&tog NMPD	&tog NMPD	___	___		&kp N0	&kp N0	&kp DOT	_x_	_x_
        )



        #define VIM_KEYMAP  \
	___,	___,	___,	___,	___,									___,	___,	___,	___,	___, \
	_x_,	&vim_1,	&vim_2,	&vim_3,	&vim_4,	&vim_5,							&vim_6,	&vim_7,	&vim_8,	&vim_9,	&kp HOME,	___, \
	___,	_x_,	&kp LC(RIGHT),	&vim_e,	_x_,	_x_,							&vim_y,	&kp LC(Z),	&vim_i,	&vim_o,	&vim_p,	___, \
	___,	&vim_a,	&vim_s,	&vim_d,	_x_,	&vim_g,							&kp LEFT,	&vim_j,	&kp UP,	&kp RIGHT,	_x_,	___, \
	___,	&ka LSHFT,	&vim_x,	&vim_c,	&vim_v,	&kp LC(LEFT),	&tog LVIM,	___,	___,	___,	___,	&tog LVIM,	&kp F3,	&kp LC(M),	_x_,	_x_,	___,	___, \
	___,	___,	___,	___,	___,		___,	___,	___,	___,	___,	___,		___,	___,	___,	___,	___


        ZKEYMAP( RVIM, GLOVE80_MAP(VIM_KEYMAP) )

        #define CMD_KEYMAP  \
	___,	___,	___,	___,	___,									___,	___,	___,	___,	___, \
	_x_,	_x_,	&kp LC(HOME),	&kp LC(UP),	&kp LC(DOWN),	&kp LC(END),							___,	___,	___,	___,	___,	___, \
	___,	&kt RSHFT,	&kp LC(RIGHT),	&kp PG_UP,	&kp PG_DN,	&kp LC(Y),							___,	___,	___,	___,	___,	___, \
	&desel,	&ht LSHFT LC(A),	&kp LEFT,	&kp UP,	&kp DOWN,	&kp RIGHT,							&kp LEFT,	&kp DOWN,	&kp UP,	&kp RIGHT,	___,	___, \
	___,	&ht LSHFT LC(Z),	&clip LC(X),	&clip LC(C),	&clip LC(V),	&kp LC(LEFT),	&tog CMD,	___,	___,	___,	___,	&tog CMD,	___,	___,	___,	___,	___,	___, \
	&kp LS(DEL),	&kp LC(INS),	&kp LS(INS),	&kp HOME,	&kp END,		___,	___,	___,	___,	&mokp LVIM LC(DEL),	&ht LSHFT LC(BSPC),		___,	___,	___,	___,	___


        ZKEYMAP( CMD, GLOVE80_MAP(CMD_KEYMAP) )

        ZKEYMAP( LVIM, GLOVE80_MAP(VIM_KEYMAP) )

        ZKEYMAP( VVIM,
	___	___	___	___	___									___	___	___	___	___
	___	___	___	___	___	___							___	___	___	___	___	___
	___	___	___	___	___	___							&vvim_y	___	___	___	&vvim_p	___
	___	___	&vvim_s	&vvim_d	___	___							___	___	___	___	___	___
	___	___	&vvim_x	&vvim_c	&vvim_off	___	___	___	___	___	___	___	___	___	___	___	___	___
	___	___	___	___	___		___	___	___	___	___	___		___	___	___	___	___
        )



        ZKEYMAP( CVIM,
	___	___	___	___	___									___	___	___	___	___
	_x_	_x_	_x_	_x_	_x_	_x_							_x_	_x_	_x_	_x_	_x_	_x_
	___	_x_	_x_	_x_	&kp LC(Y)	_x_							_x_	&kp PG_UP	_x_	_x_	_x_	_x_
	___	_x_	_x_	&kp PG_DN	&kp PG_DN	_x_							&kp LC(LEFT)	&kp LC(DOWN)	&kp LC(UP)	&kp LC(RIGHT)	_x_	_x_
	___	___	_x_	_x_	_x_	&kp PG_UP	___	___	___	___	___	___	_x_	_x_	_x_	___	___	___
	___	___	___	___	___		___	___	___	___	___	___		___	___	___	___	___
        )

        ZKEYMAP( SVIM,
	___	___	___	___	___									___	___	___	___	___
	_x_	_x_	_x_	_x_	_x_	_x_							_x_	_x_	_x_	_x_	_x_	_x_
	___	_x_	_x_	_x_	_x_	_x_							_x_	_x_	_x_	_x_	_x_	_x_
	___	_x_	_x_	_x_	_x_	_x_							&kp HOME	_x_	_x_	_x_	_x_	_x_
	___	_x_	_x_	_x_	&kp END	_x_	___	___	___	___	___	___	_x_	_x_	_x_	_x_	&kp HOME	_x_
	___	___	___	___	___		___	___	___	___	___	___		___	___	___	___	___
        )

        ZKEYMAP( SYS,
	_x_	_x_	_x_	_x_	_x_									_x_	_x_	_x_	_x_	_x_
	_x_	_x_	_x_	_x_	_x_	_x_							_x_	_x_	_x_	_x_	_x_	_x_
	___	_x_	_x_	_x_	_x_	_x_							_x_	_x_	_x_	_x_	&kp PSCRN	_x_
	___	_x_	&kp SLCK	_x_	_x_	_x_							&kp C_BRI_DN	&kp C_VOL_DN	&kp C_VOL_UP	&kp C_BRI_UP	_x_	_x_
	___	_x_	&tog MASK	_x_	_x_	&kp PAUSE_BREAK	&tog SYS	___	___	___	___	&tog SYS	&kp KP_NLCK	&kp C_MUTE	_x_	_x_	_x_	_x_
	___	___	_x_	_x_	_x_		___	___	___	___	___	___		_x_	_x_	_x_	_x_	_x_
        )

        ZKEYMAP( MGC,
	&bt BT_CLR	_x_	_x_	_x_	_x_									_x_	_x_	_x_	_x_	&bt BT_CLR_ALL
	_x_	_x_	_x_	_x_	_x_	_x_							_x_	_x_	_x_	_x_	_x_	_x_
	_x_	&rgb_ug RGB_SPI	&rgb_ug RGB_SAI	&rgb_ug RGB_HUI	&rgb_ug RGB_BRI	&rgb_ug RGB_TOG							_x_	_x_	_x_	_x_	_x_	_x_
	&bootloader	&rgb_ug RGB_SPD	&rgb_ug RGB_SAD	&rgb_ug RGB_HUD	&rgb_ug RGB_BRD	&rgb_ug RGB_EFF							_x_	_x_	_x_	_x_	_x_	&bootloader
	&sys_reset	_x_	_x_	_x_	_x_	_x_	&bt_2	&bt_3	_x_	_x_	_x_	_x_	_x_	_x_	_x_	_x_	_x_	&sys_reset
	_x_	_x_	_x_	&sys_reset	&bootloader		&bt_0	&bt_1	&out OUT_USB	_x_	_x_	_x_		&bootloader	&sys_reset	_x_	_x_	_x_
        )

        ZKEYMAP( blank1,
	___	___	___	___	___									___	___	___	___	___
	___	___	___	___	___	___							___	___	___	___	___	___
	___	___	___	___	___	___							___	___	___	___	___	___
	___	___	___	___	___	___							___	___	___	___	___	___
	___	___	___	___	___	___	___	___	___	___	___	___	___	___	___	___	___	___
	___	___	___	___	___		___	___	___	___	___	___		___	___	___	___	___
        )

        ZKEYMAP( blank2,
	_x_	_x_	_x_	_x_	_x_									_x_	_x_	_x_	_x_	_x_
	_x_	_x_	_x_	_x_	_x_	_x_							_x_	_x_	_x_	_x_	_x_	_x_
	_x_	_x_	_x_	_x_	_x_	_x_							_x_	_x_	_x_	_x_	_x_	_x_
	___	_x_	_x_	_x_	_x_	_x_							_x_	_x_	_x_	_x_	_x_	_x_
	___	_x_	_x_	_x_	_x_	_x_	___	___	___	___	___	___	_x_	_x_	_x_	_x_	_x_	___
	___	___	___	___	___		___	___	___	___	___	___		___	___	___	___	___
        )
    };
};
